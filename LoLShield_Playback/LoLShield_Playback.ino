/*
 byte array playback for the LoL shield
 
 Writen for the LoL Shield, designed by Jimmie Rodgers:
 http://jimmieprodgers.com/kits/lolshield/
 
 This needs the Charliplexing library, which you can get at the
 LoL Shield project page: https://github.com/jprodgers/LoLshield

 Created by Quin Kennedy on November 20, 2019
 Adapted from LoLShield_BasicTest by Jimmie Rodgers

  This is free software; you can redistribute it and/or
  modify it under the terms of the GNU Version 3 General Public
  License as published by the Free Software Foundation; 
  or (at your option) any later version.

  This library is distributed in the hope that it will be useful,
  but WITHOUT ANY WARRANTY; without even the implied warranty of
  MERCHANTABILITY or FITNESS FOR A PARTICULAR PURPOSE.  See the GNU
  Lesser General Public License for more details.

  You should have received a copy of the GNU Lesser General Public
  License along with this library; if not, write to the Free Software
  Foundation, Inc., 51 Franklin St, Fifth Floor, Boston, MA  02110-1301  USA
*/

#include <avr/pgmspace.h>  //AVR library for writing to ROM
#include <Charliplexing.h> //Imports the library, which needs to be
                           //Initialized in setup.

//Sets the time each frame is shown (milliseconds)
const unsigned int blinkdelay = 120;

/*
The BitMap array is what contains the frame data. Each line is one full frame.
Each number is one LED.
128 was chosen as the kill number, so make sure that
is at the end of the matrix, or the program will continue to read into memory.

Here PROGMEM is called, which stores the array into ROM, which leaves us
with our RAM. You cannot change the array during run-time, only when you
upload to the Arduino. You will need to pull it out of ROM, which is covered
below. If you want it to stay in RAM, just delete PROGMEM
*/
PROGMEM const uint8_t BitMap[][126] = {
 {0,0,0,0,0,0,0,0,0,0,0,0,0,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0,0}
,{0,0,0,0,0,0,0,0,0,0,0,0,0,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0,0}
,{0,0,0,0,0,0,0,0,0,0,0,0,0,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0,0}
,{0,0,0,0,0,0,0,0,0,0,0,0,0,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0,0}
,{0,0,0,0,0,0,0,0,0,0,0,0,0,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0,0}
,{0,5,0,0,0,0,0,0,0,0,0,0,0,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0,0}
,{0,0,0,0,0,0,0,0,0,0,0,0,0,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0,0}
,{0,0,0,0,0,0,0,0,0,0,0,0,0,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0,0}
,{0,0,0,0,0,0,0,0,0,0,0,0,0,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0,0}
,{0,0,0,0,0,0,0,0,0,0,0,0,0,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0,0}
,{0,0,0,0,0,0,0,0,0,0,0,0,0,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0,0}
,{0,0,0,0,0,0,0,0,0,0,0,0,0,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0,0}
,{0,0,0,0,0,0,0,0,0,0,0,0,0,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0,0}
,{0,0,0,0,0,0,0,0,0,0,0,0,0,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0,0}
,{0,0,0,0,0,0,0,0,0,0,0,0,0,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0,0}
,{0,0,0,0,0,0,0,0,0,0,0,0,0,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0,0}
,{0,5,0,0,0,0,0,0,0,0,0,0,0,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0,0}
,{0,0,0,0,0,0,0,0,0,0,0,0,0,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0,0}
,{0,0,0,0,0,0,0,0,0,0,0,0,0,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0,0}
,{128}
};

void setup() {
  LedSign::Init(GRAYSCALE);  //Initializes the screen
}
void loop() {
  DisplayBitMap();  //Displays the bitmap
}

void DisplayBitMap()
{
  boolean run=true;    //While this is true, the screen updates
  byte frame = 0;      //Frame counter
  uint8_t line = 0;       //Row counter
  uint8_t led = 0;        //Column counter
  uint8_t pixel = 0;      //Pixel counter
  uint8_t data;  //Temporary storage of the pixel data
  unsigned long start = millis();

  while(run == true) {
    pixel = 0;
    for(line = 0; line < 9; line++) {
      for(led = 0; led < 14; led++){
        data = pgm_read_word_near(&BitMap[frame][pixel]);
        if (data == 128){
          run = false;
          return;
        } else {
          LedSign::Set(led, line, data);
        }
        pixel++;
      }
    }

    LedSign::Flip(true);   
    
    unsigned long end = millis();
    unsigned long diff = end - start;
    if ( start && (diff < blinkdelay) ) {
        delay( blinkdelay - diff );
    }
    start = end;

    frame++;  
  }
}
